&vfx_engine {
    pixel-positions = <
        /* Left local LEDs 0..20. */
        50 0  40 0  30 0  20 0  10 0
        0 10  10 10  20 10  30 10  40 10  50 10
        50 20  40 20  30 20  20 20  10 20  0 20
        50 30  40 30  30 30  20 30

        /* Right local LEDs 0..20 (global LEDs 21..41). */
        70 0  80 0  90 0  100 0  110 0
        120 10  110 10  100 10  90 10  80 10  70 10
        70 20  80 20  90 20  100 20  110 20  120 20
        70 30  80 30  90 30  100 30
    >;

    key-pixels = <
        /* Top: left outer-to-inner, right inner-to-outer. */
        4 3 2 1 0          21 22 23 24 25
        /* Home. */
        5 6 7 8 9 10       31 30 29 28 27 26
        /* Bottom. */
        16 15 14 13 12 11  32 33 34 35 36 37
        /* Thumbs. */
        20 19 18 17        38 39 40 41
    >;
};
