## boards/shields/Kconfig.shield
```kconfig
config SHIELD_ASTRA_LEFT
    def_bool $(shields_list_contains,astra_left)

config SHIELD_ASTRA_RIGHT
    def_bool $(shields_list_contains,astra_right)
```

## boards/shields/astra/Kconfig.defconfig
```kconfig
if SHIELD_ASTRA_LEFT

config ZMK_KEYBOARD_NAME
    default "astra"

config ZMK_SPLIT_ROLE_CENTRAL
    default y

config ZMK_SPLIT_BLE_CENTRAL_BATTERY_LEVEL_FETCHING
    default y

config ZMK_SPLIT_BLE_CENTRAL_BATTERY_LEVEL_PROXY
    default y

endif

if SHIELD_ASTRA_LEFT || SHIELD_ASTRA_RIGHT

config ZMK_SPLIT
    default y

endif
```

## config/west.yml
```yaml
manifest:
  defaults:
    revision: v0.3
  remotes:
    - name: zmkfirmware
      url-base: https://github.com/zmkfirmware
    - name: pr0dt0s
      url-base: https://github.com/pr0dt0s
  projects:
    - name: zmk
      remote: zmkfirmware
      revision: main
      import: app/west.yml
    - name: zmk-advanced-underglow-effects-vfx
      remote: pr0dt0s
      revision: main
  self:
    path: config
```
